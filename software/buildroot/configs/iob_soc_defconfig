## software/buildroot/configs/iob_soc_defconfig
```kconfig
## Build options
BR2_CCACHE=y
BR2_CCACHE_DIR="$(HOME)/.buildroot-ccache-saxon_default"

## Target options
BR2_riscv=y
BR2_RISCV_32=y

## Instruction Set Extensions
BR2_riscv_custom=y
BR2_RISCV_ISA_CUSTOM_RVM=y
BR2_RISCV_ISA_CUSTOM_RVA=y
BR2_RISCV_ISA_CUSTOM_RVC=y
BR2_RISCV_ABI_ILP32=y

## Linux headers same as kernel
BR2_PACKAGE_HOST_LINUX_HEADERS_CUSTOM_5_15=y

## System
BR2_TARGET_GENERIC_GETTY=y
BR2_TARGET_GENERIC_GETTY_PORT="console"
BR2_LINUX_KERNEL_DTS_SUPPORT=y
BR2_LINUX_KERNEL_CUSTOM_DTS_PATH="$(BR2_EXTERNAL_IOB_SOC_PATH)/../iob_soc.dts"

## OpenSBI
BR2_TARGET_OPENSBI=n

## Kernel
BR2_LINUX_KERNEL=n

## Filesystem
BR2_TARGET_ROOTFS_CPIO=y
BR2_TARGET_ROOTFS_CPIO_GZIP=y
BR2_ROOTFS_DEVICE_CREATION_DYNAMIC_DEVTMPFS=y
BR2_ROOTFS_OVERLAY="$(BR2_EXTERNAL_IOB_SOC_PATH)/board/IObundle/iob-soc/rootfs-overlay"

## Extra packages
BR2_PACKAGE_DHRYSTONE=y
BR2_PACKAGE_MICROPYTHON=y
BR2_PACKAGE_DROPBEAR=y
BR2_PACKAGE_LRZSZ=y
```
